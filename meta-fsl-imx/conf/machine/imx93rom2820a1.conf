## meta-fsl-imx/conf/machine/imx93rom2820a1.conf
```bitbake
MACHINEOVERRIDES =. "imx93-11x11-lpddr4x-evk:imx93rom2820a1:"
require conf/machine/imx93-11x11-lpddr4x-evk.conf

KERNEL_DEVICETREE_BASENAME = "imx93-rom2820-a1"

# Find a better way to do it
KERNEL_DEVICETREE:remove = "\
    freescale/${KERNEL_DEVICETREE_BASENAME}-aud-hat.dtb \
    freescale/${KERNEL_DEVICETREE_BASENAME}-boe-wxga-lvds-panel.dtb \
    freescale/${KERNEL_DEVICETREE_BASENAME}-flexio-i2c.dtb \
    freescale/${KERNEL_DEVICETREE_BASENAME}-flexspi-m2.dtb \
    freescale/${KERNEL_DEVICETREE_BASENAME}-i3c.dtb \
    freescale/${KERNEL_DEVICETREE_BASENAME}-inmate.dtb \
    freescale/${KERNEL_DEVICETREE_BASENAME}-ld.dtb \
    freescale/${KERNEL_DEVICETREE_BASENAME}-lpspi-slave.dtb \
    freescale/${KERNEL_DEVICETREE_BASENAME}-lpspi.dtb \
    freescale/${KERNEL_DEVICETREE_BASENAME}-lpuart.dtb \
    freescale/${KERNEL_DEVICETREE_BASENAME}-mqs.dtb \
    freescale/${KERNEL_DEVICETREE_BASENAME}-mt9m114.dtb \
    freescale/${KERNEL_DEVICETREE_BASENAME}-rm67199.dtb \
    freescale/${KERNEL_DEVICETREE_BASENAME}-root.dtb \
    freescale/${KERNEL_DEVICETREE_BASENAME}-rpmsg.dtb \
    freescale/${KERNEL_DEVICETREE_BASENAME}-rpmsg-lpv.dtb \
    freescale/imx93-11x11-evk-iw612-otbr.dtb \
    freescale/imx93-rom2820-a1-i2c-spi-slave.dtb \
    freescale/imx93-rom2820-a1-iw612-otbr.dtb \
    "
```

## meta-fsl-imx/conf/machine/imx95aom5521a2.conf
```bitbake
#@TYPE: Machine
#@NAME: Advantech i.MX 95 AOM-5521 Board
#@SOC: i.MX95
#@DESCRIPTION: Machine configuration for Advantech i.MX 95 AOM-5521 Board
#@MAINTAINER: Advantech RISC SW Team

MACHINEOVERRIDES =. "mx95:"

require conf/machine/include/adv-imx95-evk.inc

MACHINE_FEATURES:append:use-nxp-bsp = " nxp9098-pcie"

KERNEL_DEVICETREE_BASENAME = "imx95-aom5521-a2"

UBOOT_CONFIG_BASENAME = "imx95_aom5521a2"

IMXBOOT_TARGETS_BASENAME = "flash"
OEI_BOARD  = "${@bb.utils.contains('UBOOT_CONFIG', '8G', 'mx95lp5_aom5521a2_8G', \
							  'mx95lp5', d)}"
DDR_TYPE   = "lpddr5"

DDR_FIRMWARE_NAME = " \
    lpddr5_dmem_v202409.bin \
    lpddr5_dmem_qb_v202409.bin \
    lpddr5_imem_v202409.bin \
    lpddr5_imem_qb_v202409.bin \
"
M4_DEFAULT_IMAGE_MX95 = "${@bb.utils.contains('SYSTEM_MANAGER_CONFIG', 'mx95netc', 'imx95-19x19-evk_m7_TCM_netc_share.bin', \
                                                                                   'imx95-19x19-evk_m7_TCM_power_mode_switch.bin', d)}"

IMAGE_BOOT_FILES:append = " \
    mcore-demos/imx95-19x19-evk_m7_TCM_flexcan_linux.bin \
    mcore-demos/imx95-19x19-evk_m7_TCM_low_power_wakeword.bin \
    mcore-demos/imx95-19x19-evk_m7_TCM_netc_share.bin \
    mcore-demos/imx95-19x19-evk_m7_TCM_power_mode_switch.bin \
    mcore-demos/imx95-19x19-evk_m7_TCM_rpmsg_lite_pingpong_rtos_linux_remote.bin \
    mcore-demos/imx95-19x19-evk_m7_TCM_rpmsg_lite_str_echo_rtos.bin \
    mcore-demos/imx95-19x19-evk_m7_TCM_sai_low_power_audio.bin \
    ${@bb.utils.contains('COMBINED_FEATURES', 'xen', 'xen', '', d)} \
"

# Include device trees
KERNEL_DEVICETREE += " \
    freescale/${KERNEL_DEVICETREE_BASENAME}-m2-sdio.dtb \
    freescale/${KERNEL_DEVICETREE_BASENAME}-lvds0-auo.dtb \
    freescale/${KERNEL_DEVICETREE_BASENAME}-lvds1-auo.dtb \
    freescale/${KERNEL_DEVICETREE_BASENAME}-lvds-dual.dtb \
    freescale/${KERNEL_DEVICETREE_BASENAME}-auog101uan02.dtb \
"
```
