## meta-fsl-imx/conf/machine/imx93afee320a1.conf
```bitbake
#@TYPE: Machine
#@NAME: Advantech i.MX 93 AFE-E320 Board
#@SOC: i.MX93
#@DESCRIPTION: Machine configuration for Advantech i.MX 93 AFE-E320 Board
#@MAINTAINER: Advantech RISC SW Team

MACHINEOVERRIDES =. "mx93:"

require conf/machine/include/adv-imx93-evk.inc

KERNEL_DEVICETREE_BASENAME = "imx93-afee320-a1"

KERNEL_DEVICETREE:append:use-nxp-bsp = " \
    freescale/${KERNEL_DEVICETREE_BASENAME}.dtb \
    freescale/${KERNEL_DEVICETREE_BASENAME}-lvds.dtb \
    freescale/${KERNEL_DEVICETREE_BASENAME}-m33-console.dtb \
 "

UBOOT_CONFIG_BASENAME = "imx93_afee320a1"

DDR_FIRMWARE_NAME = " \
    lpddr4_dmem_1d_v202201.bin \
    lpddr4_dmem_2d_v202201.bin \
    lpddr4_imem_1d_v202201.bin \
    lpddr4_imem_2d_v202201.bin \
"
```

## meta-fsl-imx/conf/machine/imx95aom3511a1.conf
```bitbake
#@TYPE: Machine
#@NAME: Advantech i.MX 95 AOM-3511 Board
#@SOC: i.MX95
#@DESCRIPTION: Machine configuration for Advantech i.MX 95 AOM-3511 Board
#@MAINTAINER: Advantech RISC SW Team

MACHINEOVERRIDES =. "mx95:"

require conf/machine/include/adv-imx95-evk.inc

KERNEL_DEVICETREE_BASENAME = "imx95-aom3511-a1"

UBOOT_CONFIG_BASENAME = "imx95_aom3511a1"

IMXBOOT_TARGETS_BASENAME = "flash"
OEI_BOARD  = "${@bb.utils.contains('UBOOT_CONFIG', '16G', 'mx95lp5_aom3511a1_16G', \
		 bb.utils.contains('UBOOT_CONFIG', '8G', 'mx95lp5_aom3511a1_8G', \
							 'mx95lp5', d), d)}"
DDR_TYPE   = "lpddr5"

DDR_FIRMWARE_NAME = " \
    lpddr5_dmem_v202311.bin \
    lpddr5_dmem_qb_v202311.bin \
    lpddr5_imem_v202311.bin \
    lpddr5_imem_qb_v202311.bin \
"
M4_DEFAULT_IMAGE_MX95 = "${@bb.utils.contains('SYSTEM_MANAGER_CONFIG', 'mx95netc', 'imx95-19x19-evk_m7_TCM_netc_share.bin', \
                                                                                   'imx95-19x19-evk_m7_TCM_power_mode_switch.bin', d)}"

IMAGE_BOOT_FILES:append = " \
    imx95-19x19-evk_m7_TCM_flexcan_linux.bin \
    imx95-19x19-evk_m7_TCM_low_power_wakeword.bin \
    imx95-19x19-evk_m7_TCM_netc_share.bin \
    imx95-19x19-evk_m7_TCM_power_mode_switch.bin \
    imx95-19x19-evk_m7_TCM_rpmsg_lite_pingpong_rtos_linux_remote.bin \
    imx95-19x19-evk_m7_TCM_rpmsg_lite_str_echo_rtos.bin \
    imx95-19x19-evk_m7_TCM_sai_low_power_audio.bin \
    ${@bb.utils.contains('COMBINED_FEATURES', 'xen', 'xen', '', d)} \
"
```

## meta-fsl-imx/conf/machine/include/adv-imx8mm-evk.inc
```bitbake
MACHINEOVERRIDES =. "imx-boot-container:mx8:mx8m:mx8mm:"

require conf/machine/include/imx-base.inc
require conf/machine/include/tune-cortexa53.inc

MACHINE_FEATURES += "pci wifi bluetooth bcm43455 bcm4356"

# NXP BSP can consume BCM4359 and QCA9377 driver and firmware
# Since the firmware is not available publicly, and rather distributed
# under "Proprietary" license - we opt-out from using it in all BSPs
# and pin it to NXP BSP only
# OP-TEE is also applicable to NXP BSP, mainline BSP seems not to have
# a full support for it yet.
MACHINE_FEATURES_append_use-nxp-bsp = " optee bcm4359 qca9377"

KERNEL_DEVICETREE = " \
    freescale/${KERNEL_DEVICETREE_BASENAME}.dtb \
"
KERNEL_DEVICETREE_append_use-nxp-bsp = " \
	freescale/${KERNEL_DEVICETREE_BASENAME}.dtb \
	freescale/${KERNEL_DEVICETREE_BASENAME}-adv7535.dtb \
	freescale/${KERNEL_DEVICETREE_BASENAME}-m2-sdio.dtb \
	freescale/${KERNEL_DEVICETREE_BASENAME}-dsi2lvds-g150xgel05.dtb \
        freescale/${KERNEL_DEVICETREE_BASENAME}-dsi2lvds-g215hvn01.dtb \
	freescale/${KERNEL_DEVICETREE_BASENAME}-dsi2dp.dtb \
	freescale/${KERNEL_DEVICETREE_BASENAME}-auog101uan02.dtb \
        freescale/${KERNEL_DEVICETREE_BASENAME}-rpmsg.dtb \
	freescale/${KERNEL_DEVICETREE_BASENAME}-m2-i2s.dtb \
"
UBOOT_DTB_NAME = "${KERNEL_DEVICETREE_BASENAME}.dtb"

IMX_DEFAULT_BOOTLOADER_use-nxp-bsp = "u-boot-imx"
IMX_DEFAULT_BOOTLOADER_use-mainline-bsp = "u-boot-fslc"

UBOOT_SUFFIX = "bin"

UBOOT_CONFIG ??= "2G"
UBOOT_CONFIG[2G] = "${UBOOT_CONFIG_BASENAME}_2G_defconfig,sdcard"
UBOOT_CONFIG[1G] = "${UBOOT_CONFIG_BASENAME}_1G_defconfig,sdcard"
UBOOT_CONFIG[FSPI_2G] = "${UBOOT_CONFIG_BASENAME}_2G_fspi_defconfig"
UBOOT_CONFIG[FSPI_1G] = "${UBOOT_CONFIG_BASENAME}_1G_fspi_defconfig"

SPL_BINARY = "spl/u-boot-spl.bin"

ATF_PLATFORM = "imx8mm"
ATF_LOAD_ADDR = "0x920000"

# Extra firmware package name, that is required to build boot container for fslc bsp
IMX_EXTRA_FIRMWARE = "firmware-imx-8m"

IMXBOOT_TARGETS = "${@bb.utils.contains('UBOOT_CONFIG', 'FSPI_2G FSPI_1G', '${IMXBOOT_TARGETS_BASENAME}_flexspi', '${IMXBOOT_TARGETS_BASENAME}', d)}"

IMX_BOOT_SOC_TARGET = "iMX8MM"

SERIAL_CONSOLES = "115200;ttymxc1"

LOADADDR = ""
UBOOT_SUFFIX = "bin"
UBOOT_MAKE_TARGET = "all"
IMX_BOOT_SEEK = "33"

OPTEE_BIN_EXT = "8mm"
TEE_LOAD_ADDR = "0xbe000000"

# Add additional firmware
MACHINE_FIRMWARE_append = " linux-firmware-ath10k"
```

## meta-fsl-imx/conf/machine/include/adv-imx8mp-evk.inc
```bitbake
MACHINEOVERRIDES =. "mx8mp:"

# FIXME: u-boot-imx should be converted to `binman` and then we can
# avoid this specific overrides and handle it in a generic way.
MACHINEOVERRIDES =. "${@bb.utils.contains('IMX_DEFAULT_BOOTLOADER', 'u-boot-imx', '', 'imx-boot-container:', d)}"

require conf/machine/include/imx-base.inc
require conf/machine/include/arm/armv8a/tune-cortexa53.inc

# Mainline BSP defaults to "generic" cortexa53 configuration,
# adjust it here to include crypto extension which enables
# inline NEON and FPU code generation
DEFAULTTUNE:use-mainline-bsp = "cortexa53-crypto"

MACHINE_FEATURES += "pci wifi bluetooth"

# NXP BSP can consume proprietary jailhouse and Marvell drivers
# OP-TEE is also applicable to NXP BSP, mainline BSP seems not to have
# a full support for it yet.
MACHINE_FEATURES:append:use-nxp-bsp = " optee jailhouse mrvl8997"

# Mainline kernel contains only one DTB file for
# Advantech imx8mp machine
KERNEL_DEVICETREE = " \
    freescale/${KERNEL_DEVICETREE_BASENAME}.dtb \
    freescale/${KERNEL_DEVICETREE_BASENAME}-lvds0-auo.dtb \
    freescale/${KERNEL_DEVICETREE_BASENAME}-lvds1-auo.dtb \
    freescale/${KERNEL_DEVICETREE_BASENAME}-lvds-dual.dtb \
    freescale/${KERNEL_DEVICETREE_BASENAME}-adv7535.dtb \
    freescale/${KERNEL_DEVICETREE_BASENAME}-basler.dtb \
    freescale/${KERNEL_DEVICETREE_BASENAME}-auog101uan02.dtb \
"

UBOOT_DTB_NAME = "${KERNEL_DEVICETREE_BASENAME}.dtb"

IMX_DEFAULT_BOOTLOADER:use-nxp-bsp = "u-boot-imx"
IMX_DEFAULT_BOOTLOADER:use-mainline-bsp = "u-boot-fslc"

UBOOT_SUFFIX = "bin"

WKS_FILE_DEPENDS:append = " imx-m7-demos"
IMAGE_BOOT_FILES += "imx8mp_m7_TCM_hello_world.bin \
    imx8mp_m7_TCM_low_power_voice.bin \
    imx8mp_m7_TCM_low_power_wakeword.bin \
    imx8mp_m7_TCM_rpmsg_lite_pingpong_rtos_linux_remote.bin \
    imx8mp_m7_TCM_rpmsg_lite_str_echo_rtos.bin \
    imx8mp_m7_TCM_sai_low_power_audio.bin \
"

SPL_BINARY = "spl/u-boot-spl.bin"

ATF_PLATFORM = "imx8mp"

IMXBOOT_TARGETS = \
    "${@bb.utils.contains('UBOOT_CONFIG', 'FSPI_2G FSPI_6G', '${IMXBOOT_TARGETS_BASENAME}_flexspi', \
                                                  '${IMXBOOT_TARGETS_BASENAME}', d)}"

IMX_BOOT_SOC_TARGET = "iMX8MP"

SERIAL_CONSOLES = "115200;ttymxc1"

# Add support for Syslinux to mainline BSP.
# U-Boot has the Distro Boot mode enabled by default, which
# require that either Syslinux to be enabled, or a boot script
# to be used to define the boot process.
# We opt-in for Syslinux, since it is designated as a preferred
# distro boot mode according to the U-Boot documentation.
UBOOT_EXTLINUX:use-mainline-bsp = "1"
UBOOT_EXTLINUX_LABELS:use-mainline-bsp = "default"
UBOOT_EXTLINUX_DEFAULT_LABEL:use-mainline-bsp = "i.MX8M Plus EVK"

UBOOT_EXTLINUX_MENU_DESCRIPTION:default:use-mainline-bsp = "i.MX8M Plus EVK"
UBOOT_EXTLINUX_FDT:default:use-mainline-bsp     = "../${KERNEL_DEVICETREE_BASENAME}.dtb"
UBOOT_EXTLINUX_CONSOLE:default:use-mainline-bsp = "console=${console}"
UBOOT_EXTLINUX_ROOT:default:use-mainline-bsp    = "root=/dev/mmcblk1p2"

# Add extlinux.conf to the lis of files, which are deployed onto the
# boot partition
IMAGE_BOOT_FILES:append:use-mainline-bsp = " extlinux.conf;extlinux/extlinux.conf"

LOADADDR = ""
UBOOT_MAKE_TARGET = "all"
IMX_BOOT_SEEK = "32"

OPTEE_BIN_EXT = "8mp"
TEE_LOAD_ADDR = "0x56000000"

# Add additional firmware
MACHINE_FIRMWARE:append = " linux-firmware-ath10k"
```

## meta-fsl-imx/conf/machine/include/advantech-imx6-settings.inc
```bitbake
# Provides the i.MX6 SABRE SD common settings

require conf/machine/include/imx-base.inc
require conf/machine/include/arm/armv7a/tune-cortexa9.inc

UBOOT_BINARY_ADV = "u-boot_crc_adv.bin"

SOC_DEFAULT_WKS_FILE = "adv-imx-uboot-bootpart.wks.in"

IMAGE_BOOT_FILES = " \
    ${KERNEL_IMAGETYPE} \
    ${@make_dtb_boot_files(d)} \
"
```

## meta-ti-adv/conf/layer.conf
```bitbake
# We have a conf and classes directory, append to BBPATH
BBPATH .= ":${LAYERDIR}"
METATIBASE := '${@os.path.normpath("${LAYERDIR}/")}'

# We have a recipes directory, add to BBFILES
BBFILES += "${LAYERDIR}/recipes*/*/*.bb ${LAYERDIR}/recipes*/*/*.bbappend"

BBFILE_COLLECTIONS += "advantech-ti"
BBFILE_PATTERN_advantech-ti := "^${LAYERDIR}/"
BBFILE_PRIORITY_advantech-ti = "6"

LAYERSERIES_COMPAT_advantech-ti = "dunfell"

LICENSE_PATH += "${LAYERDIR}/licenses"

LAYERDEPENDS_advantech-ti = " \
    core \
    meta-arm \
"

SIGGEN_EXCLUDERECIPES_ABISAFE += " \
    ti-sgx-ddk-km \
    ti-sgx-ddk-um \
    cmem-mod \
    hplib-mod \
    gdbserverproxy-module-drv \
    debugss-module-drv \
    uio-module-drv \
    mpm-transport \
    cppi-lld \
    qmss-lld \
    multiprocmgr \
"

HOSTTOOLS_NONFATAL += "truncate xxd comm"
```

## meta-ti-adv/conf/machine/am335xrsb4220a1.conf
```bitbake
#@TYPE: Machine
#@NAME: AM335x EVM
#@DESCRIPTION: Machine configuration for the TI AM335x EVM

require conf/machine/include/ti33x.inc
require conf/machine/include/am335x-adv.inc

MACHINE_GUI_CLASS = "smallscreen"
MACHINE_FEATURES += "touchscreen"

IMAGE_FSTYPES += "ubifs ubi tar.xz"

# Normally AM335 boards use ttyS0, so try both
SERIAL_CONSOLE = ""
SERIAL_CONSOLES = "115200;ttyS0 "
SERIAL_CONSOLES_CHECK = "${SERIAL_CONSOLES}"

KERNEL_DEVICETREE = "am335x-rsb4220a1.dtb "
UBOOT_MACHINE = "am335x_rsb4220a1_512M_config"

# UBI information.  Note that this is board and kernel specific.  Changes
# in your kernel port may require changes in these variables.  For more
# details about this board please see
# http://processors.wiki.ti.com/index.php/UBIFS_Support

# do ubiattach /dev/ubi_ctrl -m 7 -O 2048
# From dmesg:
# UBI: smallest flash I/O unit:    2048
# UBI: logical eraseblock size:    126976 bytes
# from ubiattach stdout:
# UBI device number 0, total 1988 LEBs
MKUBIFS_ARGS = "-F -m 2048 -e 126976 -c 12000"

# do ubiattach /dev/ubi_ctrl -m 7 -O 2048
# from dmesg:
# UBI: smallest flash I/O unit:    2048
# UBI: physical eraseblock size:   131072 bytes (128 KiB)
# UBI: sub-page size:              512
# UBI: VID header offset:          2048 (aligned 2048)
UBINIZE_ARGS = "-m 2048 -p 128KiB -s 512 -O 2048"

MACHINE_FEATURES_remove = "sgx"
PACKAGECONFIG_remove = "wayland-egl"

IMAGE_INSTALL_remove = "chromium-wayland"
BBMASK="meta-browser/recipes-browser/chromium/chromium-wayland_53.0.2785.143.bb meta-arago/meta-arago-distro/recipes-graphics/wayland/wayland-ivi-extension_2.1.0.bb"

MULTIMEDIA_remove_ti33x = "chromium-wayland"
GRAPHICS_WESTON_remove = "wayland-ivi-extension"
```

## meta-ti-adv/conf/machine/include/am335x-adv.inc
```bitbake
IMAGE_INSTALL += "\
   linux-firmware-bcm43241b4 "

IMAGE_INSTALL += "\
   ppp"

# Wise-PaaS
IMAGE_INSTALL += "\
   susi4 susi-iot"

# timezone
IMAGE_INSTALL += "\
   tzdata"

# minicom
IMAGE_INSTALL += "\
   minicom"

IMAGE_INSTALL += "\
   cmake \
   mosquitto-clients mosquitto mosquitto-dev \
   libxml2 libxml2-dev \
   git-perltools \
   openobex obexd \
   openobex-dev \
   python-pybluez \
   "
TOOLCHAIN_TARGET_TASK += "\
   cmake \
   git git-perltools \
   curl curl-dev \
   mosquitto-clients mosquitto mosquitto-dev \
   libxml2 libxml2-dev \
   linux-libc-headers-dev \
   openobex obexd \
   glibc-staticdev \
"

INHERIT += "own-mirrors"
SOURCE_MIRROR_URL = "http://software-dl.ti.com/processor-sdk-mirror/sources/"
```

## meta-tools/conf/layer.conf
```bitbake
BBPATH .= ":${LAYERDIR}"
BBFILES += "\
            ${LAYERDIR}/recipes-*/*/*.bb \
            ${LAYERDIR}/recipes-*/*/*.bbappend \
           "

BBFILE_COLLECTIONS += "advantech-tools"
BBFILE_PATTERN_advantech-tools := "^${LAYERDIR}/"
BBFILE_PRIORITY_advantech-tools = "25"
LAYERSERIES_COMPAT_advantech-tools = "mickledore"
IMAGE_INSTALL:append = " docker-moby"
CORE_IMAGE_EXTRA_INSTALL += "chromium-ozone-wayland"
```
