## meta-fsl-imx/conf/machine/imx8mprom5722a1.conf
```bitbake
#@TYPE: Machine
#@NAME: i.MX 8MP Consolidated`Machine
#@DESCRIPTION: A consolidated machine for i.MX 8MP LPDDR4 ROM5722 A1 Board
#@MAINTAINER: Clayder.Huang <clayder.huang@advantech.com.tw>
#
require conf/machine/include/adv-imx8mp-evk.inc

# The device tree name is implicit for LPDDR4, so can't use MACHINE here
KERNEL_DEVICETREE_BASENAME = "imx8mp-rom5722-a1"

# Mainline kernel contains only one DTB file for
# Advantech imx8mp machine
KERNEL_DEVICETREE = " \
    freescale/${KERNEL_DEVICETREE_BASENAME}.dtb \
    freescale/${KERNEL_DEVICETREE_BASENAME}-adv7535.dtb \
    freescale/${KERNEL_DEVICETREE_BASENAME}-auog101uan02.dtb \
    freescale/${KERNEL_DEVICETREE_BASENAME}-basler.dtb \
    freescale/${KERNEL_DEVICETREE_BASENAME}-m2-sdio.dtb \
    freescale/${KERNEL_DEVICETREE_BASENAME}-lvds-dual.dtb \
    freescale/${KERNEL_DEVICETREE_BASENAME}-lvds0-auo.dtb \
    freescale/${KERNEL_DEVICETREE_BASENAME}-lvds1-auo.dtb \
"

UBOOT_CONFIG_BASENAME = "imx8mp_rom5722a1"

UBOOT_CONFIG ??= "6G"
UBOOT_CONFIG[6G] = "${UBOOT_CONFIG_BASENAME}_6G_defconfig,sdcard"
UBOOT_CONFIG[4G] = "${UBOOT_CONFIG_BASENAME}_4G_defconfig,sdcard"
UBOOT_CONFIG[FSPI_6G] = "${UBOOT_CONFIG_BASENAME}_6G_defconfig"
UBOOT_CONFIG[FSPI_4G] = "${UBOOT_CONFIG_BASENAME}_4G_defconfig"
UBOOT_CONFIG[mfgtool] = "${UBOOT_CONFIG_BASENAME}_6G_defconfig"

# Set DDR FIRMWARE
DDR_FIRMWARE_VERSION = "202006"
DDR_FIRMWARE_NAME = " \
	lpddr4_pmu_train_1d_dmem_${DDR_FIRMWARE_VERSION}.bin \
	lpddr4_pmu_train_1d_imem_${DDR_FIRMWARE_VERSION}.bin \
	lpddr4_pmu_train_2d_dmem_${DDR_FIRMWARE_VERSION}.bin \
	lpddr4_pmu_train_2d_imem_${DDR_FIRMWARE_VERSION}.bin \
"

IMXBOOT_TARGETS = \
    "${@bb.utils.contains_any('UBOOT_CONFIG', 'FSPI_6G FSPI_4G', 'flash_evk_flexspi', \
                                                  'flash_evk', d)}"

# Set Serial console
SERIAL_CONSOLES = ";"
```

## meta-fsl-imx/conf/machine/imx8mprsb3720a1.conf
```bitbake
#@TYPE: Machine
#@NAME: NXP i.MX 8M Plus RSB3720 with LPDDR4
#@SOC: i.MX8MP

require conf/machine/include/adv-imx8mp-evk.inc

# The device tree name is implicit for LPDDR4, so can't use MACHINE here
KERNEL_DEVICETREE_BASENAME = "imx8mp-rsb3720-a1"

UBOOT_CONFIG_BASENAME = "imx8mp_rsb3720a1"


UBOOT_CONFIG ??= "2G"
UBOOT_CONFIG[2G] = "imx8mp_rsb3720a1_2G_defconfig,sdcard"
UBOOT_CONFIG[6G] = "imx8mp_rsb3720a1_6G_defconfig,sdcard"
UBOOT_CONFIG[FSPI_2G] = "imx8mp_rsb3720a1_2G_defconfig"
UBOOT_CONFIG[FSPI_6G] = "imx8mp_rsb3720a1_6G_defconfig"
UBOOT_CONFIG[mfgtool] = "${UBOOT_CONFIG_BASENAME}_6G_defconfig"

# Set DDR FIRMWARE
DDR_FIRMWARE_VERSION = "202006"
DDR_FIRMWARE_NAME = " \
	lpddr4_pmu_train_1d_dmem_${DDR_FIRMWARE_VERSION}.bin \
	lpddr4_pmu_train_1d_imem_${DDR_FIRMWARE_VERSION}.bin \
	lpddr4_pmu_train_2d_dmem_${DDR_FIRMWARE_VERSION}.bin \
	lpddr4_pmu_train_2d_imem_${DDR_FIRMWARE_VERSION}.bin \
"

IMXBOOT_TARGETS_BASENAME = "flash_evk"

# Set Serial console
SERIAL_CONSOLES = "115200;ttymxc2"
```

## meta-fsl-imx/conf/machine/imx8mprsb3720a1desktop.conf
```bitbake
MACHINE="imx8mprsb3720a1"
require conf/machine/imx8mprsb3720a1.conf

require conf/machine/include/ubuntubasics.inc
```

## meta-fsl-imx/conf/machine/imx8mprsb3720a2.conf
```bitbake
#@TYPE: Machine
#@NAME: i.MX 8MP Consolidated`Machine
#@DESCRIPTION: A consolidated machine for i.MX 8MP LPDDR4 RSB3720 A2 Board
#@MAINTAINER: Darren Huang <darren.huang@advantech.com.tw>
#
require conf/machine/include/adv-imx8mp-evk.inc

# The device tree name is implicit for LPDDR4, so can't use MACHINE here
KERNEL_DEVICETREE_BASENAME = "imx8mp-rsb3720-a2"

# Mainline kernel contains only one DTB file for
# Advantech imx8mp machine
KERNEL_DEVICETREE = " \
    freescale/${KERNEL_DEVICETREE_BASENAME}.dtb \
"

UBOOT_CONFIG_BASENAME = "imx8mp_rsb3720a2"

UBOOT_CONFIG ??= "6G"
UBOOT_CONFIG[6G] = "${UBOOT_CONFIG_BASENAME}_6G_defconfig,sdcard"
UBOOT_CONFIG[FSPI_6G] = "${UBOOT_CONFIG_BASENAME}_6G_defconfig"
UBOOT_CONFIG[mfgtool] = "${UBOOT_CONFIG_BASENAME}_6G_defconfig"

# Set DDR FIRMWARE
DDR_FIRMWARE_VERSION = "202006"
DDR_FIRMWARE_NAME = " \
	lpddr4_pmu_train_1d_dmem_${DDR_FIRMWARE_VERSION}.bin \
	lpddr4_pmu_train_1d_imem_${DDR_FIRMWARE_VERSION}.bin \
	lpddr4_pmu_train_2d_dmem_${DDR_FIRMWARE_VERSION}.bin \
	lpddr4_pmu_train_2d_imem_${DDR_FIRMWARE_VERSION}.bin \
"

IMXBOOT_TARGETS = \
    "${@bb.utils.contains_any('UBOOT_CONFIG', 'FSPI_6G', 'flash_evk_flexspi', \
                                                  'flash_evk', d)}"

# Set Serial console
SERIAL_CONSOLES = "115200;ttymxc2"

ATF_BOOT_UART_BASE = "0x30880000"
```

## meta-fsl-imx/conf/machine/imx8mqrom5720a1.conf
```bitbake
#@TYPE: Machine
#@NAME: NXP i.MX 8M Quad EVK
#@SOC: i.MX8MQ
#@DESCRIPTION: Machine configuration for NXP i.MX 8M Quad Evaluation Kit
#@MAINTAINER: Jun Zhu <junzhu@nxp.com>

MACHINEOVERRIDES =. "mx8mq:"

require conf/machine/include/imx-base.inc
require conf/machine/include/arm/armv8a/tune-cortexa53.inc

# Mainline BSP defaults to "generic" cortexa53 configuration,
# adjust it here to include crypto extension which enables
# inline NEON and FPU code generation
DEFAULTTUNE:use-mainline-bsp = "cortexa53-crypto"

MACHINE_FEATURES += "pci wifi bluetooth"
MACHINE_FEATURES:append:use-nxp-bsp = " bcm4359"
MACHINE_FEATURES:remove:use-nxp-bsp = " optee"

MACHINE_SOCARCH_FILTER:append:mx8mq = " virtual/libopenvg virtual/libgles1 virtual/libgles2 virtual/egl virtual/mesa virtual/libgl virtual/libg2d"
KERNEL_DEVICETREE = "\
    freescale/imx8mq-rom5720-a1.dtb \
    freescale/imx8mq-rom5720-a1-lcdif-adv7535.dtb \
    freescale/imx8mq-rom5720-a1-dcss-adv7535.dtb \
    freescale/imx8mq-rom5720-a1-m2-sdio.dtb \
    freescale/imx8mq-rom5720-a1-dcss-auog101uan02.dtb \
    freescale/imx8mq-rom5720-a1-otg.dtb \
    freescale/imx8mq-rom5720-a1-dual-display.dtb \
"

IMX_DEFAULT_BOOTLOADER:use-nxp-bsp = "u-boot-imx"
IMX_DEFAULT_BOOTLOADER:use-mainline-bsp = "u-boot-fslc"

UBOOT_SUFFIX = "bin"

UBOOT_CONFIG ??= "2G"
UBOOT_CONFIG[2G] = "imx8mq_rom5720a1_2G_config,sdcard"

SPL_BINARY = "spl/u-boot-spl.bin"

# Set DDR FIRMWARE
DDR_FIRMWARE_NAME = " \
    lpddr4_pmu_train_1d_imem.bin \
    lpddr4_pmu_train_1d_dmem.bin \
    lpddr4_pmu_train_2d_imem.bin \
    lpddr4_pmu_train_2d_dmem.bin \
"

# Set u-boot DTB
UBOOT_DTB_NAME = "imx8mq-rom5720-a1.dtb"

# Set ATF platform name
ATF_PLATFORM = "imx8mq"

# Set imx-mkimage boot target
IMXBOOT_TARGETS = "flash_evk flash_evk_no_hdmi flash_dp_evk"
IMX_BOOT_SOC_TARGET = "iMX8M"

# Add support for Syslinux to mainline BSP.
# U-Boot has the Distro Boot mode enabled by default, which
# require that either Syslinux to be enabled, or a boot script
# to be used to define the boot process.
# We opt-in for Syslinux, since it is designated as a preferred
# distro boot mode according to the U-Boot documentation.
UBOOT_EXTLINUX:use-mainline-bsp = "1"
UBOOT_EXTLINUX_LABELS:use-mainline-bsp = "default"
UBOOT_EXTLINUX_DEFAULT_LABEL:use-mainline-bsp = "i.MX8M Quad EVK"

UBOOT_EXTLINUX_MENU_DESCRIPTION:default:use-mainline-bsp = "i.MX8M Quad EVK"
UBOOT_EXTLINUX_FDT:default:use-mainline-bsp     = "../imx8mq-evk.dtb"
UBOOT_EXTLINUX_CONSOLE:default:use-mainline-bsp = "console=${console}"
UBOOT_EXTLINUX_ROOT:default:use-mainline-bsp    ??= "root=/dev/mmcblk1p2"

# Add extlinux.conf to the lis of files, which are deployed onto the
# boot partition
IMAGE_BOOT_FILES:append:use-mainline-bsp = " extlinux.conf;extlinux/extlinux.conf"

LOADADDR = ""
UBOOT_MAKE_TARGET = ""
IMX_BOOT_SEEK = "33"

OPTEE_BIN_EXT = "8mq"

# Add additional firmware
MACHINE_FIRMWARE:append = " linux-firmware-ath10k"
```

## meta-fsl-imx/conf/machine/imx8qmrom7720a1.conf
```bitbake
#@TYPE: Machine
#@NAME: i.MX 8QM ROM7720 A1
#@DESCRIPTION: i.MX 8QM ROM-7720 board


MACHINEOVERRIDES =. "mx8:mx8qm:"

require conf/machine/include/imx-base.inc
require conf/machine/include/arm/arch-arm64.inc
require conf/machine/include/advantech-imx8-settings.inc

MACHINE_FEATURES_append = " bcm43455 bcm4356 bcm4359"

# Don't include kernels in standard images
RDEPENDS_${KERNEL_PACKAGE_NAME}-base = ""
RDEPENDS_${KERNEL_PACKAGE_NAME}-image = ""

LOADADDR = ""

# Disable the serial console due to auto-serial-console
SERIAL_CONSOLES = "115200;ttyAMA0"

# we do not want to have getty running on tty1 as we run
# auto-serial-console there
USE_VT = "0"

KERNEL_DEVICETREE = "freescale/imx8qm-rom7720-a1.dtb \
                     freescale/imx8qm-rom7720-a1-lvds0.dtb \
                     freescale/imx8qm-rom7720-a1-lvds1.dtb \
                     freescale/imx8qm-rom7720-a1-lvds-dual.dtb \
                     freescale/imx8qm-rom7720-a1-hdmi-lvds0.dtb \
                     freescale/imx8qm-rom7720-a1-hdmi-lvds1.dtb \
                     freescale/imx8qm-rom7720-a1-hdmi-lvds-dual.dtb \
                     freescale/imx8qm-rom7720-a1-sgtl5000.dtb \
                     freescale/imx8qm-rom7720-a1-it6263.dtb \
                     freescale/recovery-imx8qm-rom7720-a1.dtb"

UBOOT_MAKE_TARGET = \
    "${@bb.utils.contains('COMBINED_FEATURES', 'optee', '', \
                                                        'u-boot.bin', d)}"
SPL_BINARY = \
    "${@bb.utils.contains('COMBINED_FEATURES', 'optee', 'spl/u-boot-spl.bin', \
                                                        '', d)}"

UBOOT_MAKE_TARGET = "u-boot.bin"
UBOOT_SUFFIX = "bin"
UBOOT_CONFIG ??= "4G"
UBOOT_CONFIG[4G] = "imx8qm_rom7720a1_4G_defconfig,sdcard"
UBOOT_CONFIG[FSPI_4G] = "imx8qm_rom7720a1_4G_fspi_defconfig"

BOOT_SPACE = "131072"
IMAGE_BOOTLOADER = "imx-boot"
IMX_BOOT_SEEK = "32"

WKS_FILE_DEPENDS_append = " firmware-imx-8"
IMAGE_BOOT_FILES += "hdmitxfw.bin m4_0.bin m4_1.bin"

IMXBOOT_TARGETS_SD = \
    "${@bb.utils.contains('COMBINED_FEATURES', 'optee', 'flash_spl flash_linux_m4', \
                                                        'flash flash_regression_linux_m4', d)}"
IMXBOOT_TARGETS_FSPI = \
    "${@bb.utils.contains('COMBINED_FEATURES', 'optee', 'flash_spl_flexspi', \
                                                        'flash_flexspi', d)}"
IMXBOOT_TARGETS = \
    "${@bb.utils.contains_any('UBOOT_CONFIG', 'FSPI_4G', '${IMXBOOT_TARGETS_FSPI}', \
                                                '${IMXBOOT_TARGETS_SD}' , d)}"

BOARD_TYPE = "mek"

# Add additional firmware
MACHINE_FIRMWARE_append = " linux-firmware-ath10k"
```

## meta-fsl-imx/conf/machine/imx8qxprom3620a1.conf
```bitbake
#@TYPE: Machine
#@NAME: i.MX 8QXP ROM3620 A1
#@DESCRIPTION: i.MX 8QXP ROM-3620 board

MACHINEOVERRIDES =. "mx8:mx8x:mx8qxp:mx8qxpc0:"

require conf/machine/include/imx-base.inc
require conf/machine/include/tune-cortexa35.inc
require conf/machine/include/advantech-imx8-settings.inc

MACHINE_FEATURES_append = " bcm43455 bcm4356 bcm4359"

# Don't include kernels in standard images
RDEPENDS_${KERNEL_PACKAGE_NAME}-base = ""
RDEPENDS_${KERNEL_PACKAGE_NAME}-image = ""

LOADADDR = ""

# Disable the serial console due to auto-serial-console
SERIAL_CONSOLES = "115200;ttyAMA0"

# we do not want to have getty running on tty1 as we run
# auto-serial-console there
USE_VT = "0"

KERNEL_DEVICETREE = "freescale/imx8qxp-rom3620-a1.dtb \
			freescale/imx8qxp-rom3620-a1-lvds0-auo.dtb \
			freescale/imx8qxp-rom3620-a1-lvds1-auo.dtb \
			freescale/imx8qxp-rom3620-a1-hdmi-bridge.dtb \
			freescale/imx8qxp-rom3620-a1-lvds-chimei.dtb \
			freescale/imx8qxp-rom3620-a1-lvds-dual.dtb \
			freescale/imx8qxp-rom3620-a1-auog101uan02.dtb \
			freescale/recovery-imx8qxp-rom3620-a1.dtb "

UBOOT_MAKE_TARGET = \
    "${@bb.utils.contains('COMBINED_FEATURES', 'optee', '', \
                                                        'u-boot.bin', d)}"
SPL_BINARY = \
    "${@bb.utils.contains('COMBINED_FEATURES', 'optee', 'spl/u-boot-spl.bin', \
                                                        '', d)}"

UBOOT_MAKE_TARGET = "u-boot.bin"
UBOOT_SUFFIX = "bin"
UBOOT_CONFIG ??= "2G"
UBOOT_CONFIG[2G] = "imx8qxp_rom3620a1_2G_defconfig,sdcard"
UBOOT_CONFIG[FSPI_2G] = "imx8qxp_rom3620a1_2G_fspi_defconfig"

BOOT_SPACE = "65536"
IMAGE_BOOTLOADER = "imx-boot"
IMX_BOOT_SEEK = "32"

IMXBOOT_TARGETS_SD = \
    "${@bb.utils.contains('COMBINED_FEATURES', 'optee', 'flash_spl flash_linux_m4', \
                                                        'flash flash_regression_linux_m4', d)}"
IMXBOOT_TARGETS_FSPI = \
    "${@bb.utils.contains('COMBINED_FEATURES', 'optee', 'flash_spl_flexspi', \
                                                        'flash_flexspi', d)}"
IMXBOOT_TARGETS = \
    "${@bb.utils.contains_any('UBOOT_CONFIG', 'FSPI_2G', '${IMXBOOT_TARGETS_FSPI}', \
                                                '${IMXBOOT_TARGETS_SD}' , d)}"

BOARD_TYPE = "mek"

# Add additional firmware
MACHINE_FIRMWARE_append = " linux-firmware-ath10k"
```

## meta-fsl-imx/conf/machine/imx8qxprom5620a1.conf
```bitbake
#@TYPE: Machine
#@NAME: i.MX 8QXP ROM5620 A1
#@DESCRIPTION: i.MX 8QXP ROM-5620 board

MACHINEOVERRIDES =. "mx8:mx8qxp:"

require conf/machine/include/imx-base.inc
require conf/machine/include/arm/arch-arm64.inc
require conf/machine/include/advantech-imx8-settings.inc

MACHINE_FEATURES_append = " qca6174 bcm43455 bcm4356 bcm4359"

# Don't include kernels in standard images
RDEPENDS_${KERNEL_PACKAGE_NAME}-base = ""
RDEPENDS_${KERNEL_PACKAGE_NAME}-image = ""

LOADADDR = ""

# Disable the serial console due to auto-serial-console
SERIAL_CONSOLES = "115200;ttyAMA0"

# we do not want to have getty running on tty1 as we run
# auto-serial-console there
USE_VT = "0"

KERNEL_DEVICETREE = "freescale/adv-imx8qxp-rom5620-a1.dtb \
			freescale/adv-imx8qxp-rom5620-a1-m2-sdio.dtb \
			freescale/adv-imx8qxp-rom5620-a1-lvds0-auo.dtb \
			freescale/adv-imx8qxp-rom5620-a1-lvds1-auo.dtb \
			freescale/adv-imx8qxp-rom5620-a1-hdmi-bridge.dtb \
			freescale/adv-imx8qxp-rom5620-a1-lvds-chimei.dtb \
			freescale/adv-imx8qxp-rom5620-a1-lvds-dual.dtb \
			freescale/adv-imx8qxp-rom5620-a1-auog101uan02.dtb \
			freescale/adv-imx8qxp-rom5620-a1-qspi-b.dtb "

UBOOT_MAKE_TARGET = \
    "${@bb.utils.contains('COMBINED_FEATURES', 'optee', '', \
                                                        'u-boot.bin', d)}"
SPL_BINARY = \
    "${@bb.utils.contains('COMBINED_FEATURES', 'optee', 'spl/u-boot-spl.bin', \
                                                        '', d)}"
UBOOT_SUFFIX = "bin"
UBOOT_CONFIG ??= "2G"
UBOOT_CONFIG[2G] = "imx8qxp_rom5620a1_2G_defconfig,sdcard"
UBOOT_CONFIG[FSPI_2G] = "imx8qxp_rom5620a1_2G_fspi_defconfig"


BOOT_SPACE = "65536"
IMAGE_BOOTLOADER = "imx-boot"
IMX_BOOT_SEEK = "32"

IMXBOOT_TARGETS_SD = \
    "${@bb.utils.contains('COMBINED_FEATURES', 'optee', 'flash_spl flash_linux_m4', \
                                                        'flash flash_regression_linux_m4', d)}"
IMXBOOT_TARGETS_FSPI = \
    "${@bb.utils.contains('COMBINED_FEATURES', 'optee', 'flash_spl_flexspi', \
                                                        'flash_flexspi', d)}"
IMXBOOT_TARGETS = \
    "${@bb.utils.contains('UBOOT_CONFIG',         'sd', '${IMXBOOT_TARGETS_SD}', \
                                                        '${IMXBOOT_TARGETS_FSPI}', d)}"

BOARD_TYPE = "mek"
```

## meta-fsl-imx/conf/machine/imx8ulprom2620a1.conf
```bitbake
#@TYPE: Machine
#@NAME: i.MX 8ULP EVK
#@SOC: i.MX8ULP
#@DESCRIPTION: Machine configuration for NXP i.MX 8ULP Evaluation Kit with LPDDR4
#@MAINTAINER: Jun Zhu <junzhu@nxp.com>

require conf/machine/include/adv-imx8ulp-evk.inc

# The device tree name is implicit for LPDDR4, so can't use MACHINE here
KERNEL_DEVICETREE_BASENAME = "imx8ulp-rom2620-a1"

UBOOT_CONFIG_BASENAME = "imx8ulp_rom2620a1"

MACHINE_FEATURES += "soc-reva1"
UPOWER_FIRMWARE_NAME = "upower_a1.bin"
SECO_FIRMWARE_NAME = "mx8ulpa1-ahab-container.img"
```
