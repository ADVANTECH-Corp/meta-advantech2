## conf/machine/am62xx-rs10-k3r5-hs-fs.conf
```bitbake
#@TYPE: Machine
#@NAME: AM62xx HS-FS EVM (R5F)
#@DESCRIPTION: Machine configuration for the TI AM62xx HS-FS EVM (R5F core)

# Booting HS-FS requires different SYSFW, the rest is handled at runtime

require conf/machine/include/k3r5.inc
SOC_FAMILY_append = ":k3r5-hs-fs"

SYSFW_SOC = "am62x"
SYSFW_CONFIG = "evm"
SYSFW_SUFFIX = "hs-fs"

SYSFW_TIBOOT3_SYMLINK = ""

UBOOT_MACHINE = "am62x_rs10_r5_defconfig"

SPL_BINARY = ""
UBOOT_BINARY = "u-boot-spl.${UBOOT_SUFFIX}"
UBOOT_IMAGE = "u-boot-r5spl-hs-fs-${MAINMACHINE}-${PV}-${PR}.${UBOOT_SUFFIX}"
UBOOT_SYMLINK = "u-boot-r5spl-hs-fs.${UBOOT_SUFFIX}"
```

## conf/machine/am62xx-rs10.conf
```bitbake
#@TYPE: Machine
#@NAME: AM62XX EVM
#@DESCRIPTION: Machine configuration for the TI AM62XX EVM

require conf/machine/include/am62xx-rs10.inc

MACHINE_FEATURES += "gpu"

KERNEL_DEVICETREE = " \
    ti/k3-am62x-rs10.dtb \
"

UBOOT_MACHINE = "am62x_rs10_a53_defconfig"
KBUILD_DEFCONFIG = "tisdk_am62xx-rs10_qmi_defconfig"

SPL_BINARY = "tispl.bin_HS"
UBOOT_BINARY = "u-boot.img_HS"
UBOOT_SYMLINK = "u-boot.img"

IMAGE_BOOT_FILES_remove = "uEnv.txt"
IMAGE_BOOT_FILES_remove = "wificfg"
```

## conf/machine/include/am62xx-rs10.inc
```bitbake
require conf/machine/include/k3.inc
SOC_FAMILY_append = ":am62xx"

MACHINE_FEATURES += "screen touchscreen"

SERIAL_CONSOLES = "115200;ttyS2"
SERIAL_CONSOLES_CHECK = "${SERIAL_CONSOLES}"

TFA_K3_SYSTEM_SUSPEND = "1"

# Default tiboot3.bin on AM62x is for GP
BBMULTICONFIG = "k3r5-gp"
do_image_wic[mcdepends] = "mc::k3r5-gp:ti-sci-fw:do_deploy"
do_image_tar[mcdepends] = "mc::k3r5-gp:ti-sci-fw:do_deploy"

# Since default tiboot3.bin on AM62x is for GP, add a version for HS-FS
BBMULTICONFIG += "k3r5-hs-fs"
IMAGE_BOOT_FILES += " tiboot3-am62x-hs-fs-evm.bin"
do_image_wic[mcdepends] += "mc::k3r5-hs-fs:ti-sci-fw:do_deploy"
do_image_tar[mcdepends] += "mc::k3r5-hs-fs:ti-sci-fw:do_deploy"

# Since default tiboot3.bin on AM62x is for GP, add a version for HS-SE
BBMULTICONFIG += "k3r5-hs-se"
IMAGE_BOOT_FILES += " tiboot3-am62x-hs-evm.bin"
do_image_wic[mcdepends] += "mc::k3r5-hs-se:ti-sci-fw:do_deploy"
do_image_tar[mcdepends] += "mc::k3r5-hs-se:ti-sci-fw:do_deploy"

TFA_BOARD = "lite"
OPTEEMACHINE = "k3-am62x"
OPTEEOUTPUTMACHINE = "k3"
```

## meta-WISE-PaaS/conf/layer.conf
```bitbake
# We have a conf and classes directory, add to BBPATH
BBPATH .= ":${LAYERDIR}"
BBFILES += "\
            ${LAYERDIR}/recipes-*/*/*.bb \
            ${LAYERDIR}/recipes-*/*/*.bbappend \
           "

BBFILE_COLLECTIONS += "advantech-addons"
BBFILE_PATTERN_advantech-addons = "^${LAYERDIR}/"
BBFILE_PRIORITY_advantech-addons = "10"
LAYERSERIES_COMPAT_advantech-addons = "rocko sumo"

# do not error out on bbappends for missing recipes
BB_DANGLINGAPPENDS_WARNONLY = "true"
```

## meta-fsl-imx/conf/layer.conf
```bitbake
# We have a conf and classes directory, add to BBPATH
BBPATH .= ":${LAYERDIR}"

# We have a packages directory, add to BBFILES
BBFILES += "${LAYERDIR}/recipes-*/*/*.bb \
            ${LAYERDIR}/recipes-*/*/*.bbappend"

BBFILE_COLLECTIONS += "advantech"
BBFILE_PATTERN_advantech := "^${LAYERDIR}"
BBFILE_PRIORITY_advantech = "8"
LAYERSERIES_COMPAT_advantech = "sumo"

BBMASK += "meta-freescale/recipes-graphics/clutter/clutter-1.0_%.bbappend"
BBMASK += "meta-freescale/recipes-graphics/cogl/cogl-1.0_%.bbappend"
BBMASK += "meta-freescale/recipes-graphics/imx-gpu-viv/imx-gpu-viv_5.0.11.p8.6-hfp.bb"
BBMASK += "meta-freescale/recipes-graphics/mesa/mesa-demos_%.bbappend"
BBMASK += "meta-freescale/recipes-graphics/xorg-driver/xf86-video-imxfb-vivante_5.0.11.p8.6.bb"

HOSTTOOLS_NONFATAL_append = " sha384sum xxd"

# Enable optee for all builds using this layer, assuming the machine supports it.
# To remove optee from the build, add the following line to local.conf:
# DISTRO_FEATURES_remove = "optee"
# DEPRECATED: The ability to remove optee from the build is deprecated and
# will be removed in some future release.
DISTRO_FEATURES_append = " optee"

DISTRO_FEATURES_FILTER_NATIVESDK += "wayland"
```

## meta-fsl-imx/conf/machine/imx6dlrom5420b1.conf
```bitbake
#@TYPE: Machine
#@NAME: NXP i.MX6QP/Q/DL SABRE Smart Device
#@SOC: i.MX6QP/Q/DL
#@DESCRIPTION: Machine configuration for NXP i.MX6QP/Q/DL SABRE Smart Device
#@MAINTAINER: Otavio Salvador <otavio@ossystems.com.br>
#
# This machine replaces the following machines:
#    * imx6qpsabresd
#    * imx6qsabresd
#    * imx6dlsabresd
#    * imx6solosabresd
# and is able to work for all the machines.

MACHINEOVERRIDES =. "mx6:mx6dl:"

require conf/machine/include/imx-base.inc
require conf/machine/include/tune-cortexa9.inc
require conf/machine/include/advantech-imx6-settings.inc

KERNEL_DEVICETREE = "imx6dl-rom5420-b1.dtb"

UBOOT_CONFIG ??= "1G"
UBOOT_CONFIG[1G] = "mx6solorom5420b1_1G_config,sdcard"

UBOOT_MAKE_TARGET += "all"
SPL_BINARY = "SPL"

SERIAL_CONSOLE = "115200 ttymxc0"

MACHINE_FIRMWARE_append_mx6 = " linux-firmware-ath6k"

MACHINE_FEATURES += " pci wifi bluetooth"
```

## meta-fsl-imx/conf/machine/imx6dlrsb4411a2.conf
```bitbake
#@TYPE: Machine
#@NAME: NXP i.MX6DL SABRE Smart Device
#@SOC: i.MX6DL
#@DESCRIPTION: Machine configuration for NXP i.MX6DL SABRE Smart Device
#@MAINTAINER: Otavio Salvador <otavio@ossystems.com.br>

MACHINEOVERRIDES =. "mx6:mx6dl:"

require conf/machine/include/advantech-imx6-settings.inc

KERNEL_DEVICETREE = "imx6dl-rsb4411-a2.dtb"

UBOOT_CONFIG ??= "2G"
UBOOT_CONFIG[2G] = "mx6dlrsb4411a2_2G_config,sdcard"

SPL_BINARY = "SPL"

SERIAL_CONSOLE = "115200 ttymxc0"

MACHINE_FIRMWARE:append:mx6 = " linux-firmware-ath6k"
MACHINE_FEATURES += " pci wifi bluetooth"
```

## meta-fsl-imx/conf/machine/imx6qrsb3430a1.conf
```bitbake
#@TYPE: Machine
#@NAME: NXP i.MX6Q SABRE Smart Device
#@SOC: i.MX6Q
#@DESCRIPTION: Machine configuration for NXP i.MX6Q SABRE Smart Device
#@MAINTAINER: Otavio Salvador <otavio@ossystems.com.br>

MACHINEOVERRIDES =. "mx6:mx6q:"

require conf/machine/include/advantech-imx6-settings.inc

KERNEL_DEVICETREE = "imx6q-rsb3430-a1.dtb"

UBOOT_CONFIG ??= "1G"
UBOOT_CONFIG[1G] = "mx6qrsb3430a1_1G_config,sdcard"

SPL_BINARY = "SPL"

SERIAL_CONSOLE = "115200 ttymxc1"

MACHINE_FIRMWARE_append_mx6 = " linux-firmware-ath6k"
MACHINE_FEATURES += " pci wifi bluetooth"
```

## meta-fsl-imx/conf/machine/imx6qrsb4410a1.conf
```bitbake
#@TYPE: Machine
#@NAME: NXP i.MX6Q SABRE Smart Device
#@SOC: i.MX6Q
#@DESCRIPTION: Machine configuration for NXP i.MX6Q SABRE Smart Device
#@MAINTAINER: Otavio Salvador <otavio@ossystems.com.br>

MACHINEOVERRIDES =. "mx6:mx6q:"

require conf/machine/include/advantech-imx6-settings.inc

KERNEL_DEVICETREE = "imx6q-rsb4410-a1.dtb"

UBOOT_CONFIG ??= "1G"
UBOOT_CONFIG[1G] = "mx6qrsb4410a1_1G_config,sdcard"

UBOOT_MAKE_TARGET += "all"
SPL_BINARY = "SPL"

SERIAL_CONSOLE = "115200 ttymxc0"

MACHINE_FIRMWARE_append_mx6 = " linux-firmware-ath6k"
MACHINE_FEATURES += " pci wifi bluetooth"
```

## meta-fsl-imx/conf/machine/imx7debcrm01a1.conf
```bitbake
#@TYPE: Machine
#@NAME: Freescale i.MX7D SABRE Smart Device
#@SOC: i.MX7D
#@DESCRIPTION: Machine configuration for Freescale i.MX7D SABRE Smart Device
#@MAINTAINER: Lauren Post <Lauren.Post@nxp.com>

MACHINEOVERRIDES =. "mx7:mx7d"

require conf/machine/include/imx-base.inc
require conf/machine/include/tune-cortexa7.inc
require conf/machine/include/advantech-default-settings.inc

KERNEL_DEVICETREE = "imx7d-ebcrm01-a1.dtb"

UBOOT_CONFIG ??= "2G_IM"
UBOOT_CONFIG[2G_IM] = "mx7debcrm01a1_2G_IM_config,sdcard"

XSERVER += "mesa-driver-swrast"

UBOOT_MAKE_TARGET += "all"
SPL_BINARY = "SPL"

SERIAL_CONSOLE = "115200 ttymxc0"

MACHINE_FIRMWARE_append_mx6 = " linux-firmware-ath6k"

MACHINE_FEATURES += " pci wifi bluetooth"
```

## meta-fsl-imx/conf/machine/imx8mmebcrs08a2.conf
```bitbake
#@TYPE: Machine
#@NAME: NXP i.MX8MM LPDDR4 Evaluation Kit
#@SOC: i.MX8MM
#@DESCRIPTION: Machine configuration for NXP i.MX8MMini LPDDR4 EVK
#@MAINTAINER: Jun Zhu <junzhu@nxp.com>

MACHINEOVERRIDES =. "mx8:mx8m:mx8mm:"

require conf/machine/include/imx-base.inc
require conf/machine/include/tune-cortexa53.inc

MACHINE_FEATURES += " pci wifi bluetooth optee"


KERNEL_DEVICETREE += "freescale/imx8mm-ebcrs08-a2.dtb " 

WKS_FILE_DEPENDS_mx8 += "imx-m4-demos"
IMAGE_BOOT_FILES += "imx8mm_m4_TCM_hello_world.bin \
                    imx8mm_m4_TCM_rpmsg_lite_pingpong_rtos_linux_remote.bin \
                    imx8mm_m4_TCM_rpmsg_lite_str_echo_rtos.bin \
                    imx8mm_m4_TCM_sai_low_power_audio.bin \
"

UBOOT_CONFIG ??= "2G"
UBOOT_CONFIG[1G] = "imx8mm_ebcrs08a2_1G_config,sdcard"
UBOOT_CONFIG[2G] = "imx8mm_ebcrs08a2_2G_config,sdcard"
UBOOT_CONFIG[FSPI_1G] = "imx8mm_ebcrs08a2_1G_fspi_defconfig"
UBOOT_CONFIG[FSPI_2G] = "imx8mm_ebcrs08a2_2G_fspi_defconfig"

SPL_BINARY = "spl/u-boot-spl.bin"

# Set DDR FIRMWARE
DDR_FIRMWARE_NAME = "lpddr4_pmu_train_1d_imem.bin lpddr4_pmu_train_1d_dmem.bin lpddr4_pmu_train_2d_imem.bin lpddr4_pmu_train_2d_dmem.bin"

# Set u-boot DTB
UBOOT_DTB_NAME = "imx8mm-ebcrs08-a2.dtb"

# Set imx-mkimage boot target
IMXBOOT_TARGETS = "${@bb.utils.contains_any('UBOOT_CONFIG', 'FSPI_1G FSPI_2G', 'flash_evk_flexspi', 'flash_evk', d)}"

SERIAL_CONSOLES = "115200;ttymxc1"

IMAGE_BOOTLOADER = "imx-boot"

LOADADDR = ""
IMX_BOOT_SEEK = "33"
```

## meta-fsl-imx/conf/machine/imx8mmebcrs12a1.conf
```bitbake
#@TYPE: Machine
#@NAME: NXP i.MX 8M Mini ROM5721 with LPDDR4
#@SOC: i.MX8MM

require conf/machine/include/adv-imx8mm-evk.inc

# The device tree name is implicit for LPDDR4, so can't use MACHINE here
KERNEL_DEVICETREE_BASENAME = "imx8mm-ebcrs12-a1"

UBOOT_CONFIG_BASENAME = "imx8mm_ebcrs12a1"

DDR_FIRMWARE_NAME = " \
        lpddr4_pmu_train_1d_imem.bin \
        lpddr4_pmu_train_1d_dmem.bin \
        lpddr4_pmu_train_2d_imem.bin \
        lpddr4_pmu_train_2d_dmem.bin \
"

IMXBOOT_TARGETS_BASENAME = "flash_evk"
```

## meta-fsl-imx/conf/machine/imx8mmrom5721a1.conf
```bitbake
#@TYPE: Machine
#@NAME: NXP i.MX8MM LPDDR4 Evaluation Kit
#@SOC: i.MX8MM
#@DESCRIPTION: Machine configuration for NXP i.MX8MMini LPDDR4 EVK
#@MAINTAINER: Jun Zhu <junzhu@nxp.com>

MACHINEOVERRIDES =. "mx8:mx8m:mx8mm:"

require conf/machine/include/imx-base.inc
require conf/machine/include/tune-cortexa53.inc

MACHINE_FEATURES += " pci wifi bluetooth optee"


KERNEL_DEVICETREE += "freescale/imx8mm-rom5721-a1.dtb freescale/imx8mm-rom5721-a1-m2-sdio.dtb" 
KERNEL_DEVICETREE += "freescale/imx8mm-rom5721-a1-adv7535.dtb freescale/imx8mm-rom5721-a1-dsi2dp.dtb" 
KERNEL_DEVICETREE += "freescale/imx8mm-rom5721-a1-dsi2lvds-g150xgel05.dtb freescale/imx8mm-rom5721-a1-dsi2lvds-g215hvn01.dtb" 
KERNEL_DEVICETREE += "freescale/imx8mm-rom5721-a1-auog101uan02.dtb" 
KERNEL_DEVICETREE += "freescale/imx8mm-rom5721-a1-m4.dtb freescale/imx8mm-rom5721-a1-m2-i2s.dtb" 

WKS_FILE_DEPENDS_mx8 += "imx-m4-demos"
IMAGE_BOOT_FILES += "imx8mm_m4_TCM_hello_world.bin \
                    imx8mm_m4_TCM_rpmsg_lite_pingpong_rtos_linux_remote.bin \
                    imx8mm_m4_TCM_rpmsg_lite_str_echo_rtos.bin \
                    imx8mm_m4_TCM_sai_low_power_audio.bin \
"

UBOOT_CONFIG ??= "sd"
UBOOT_CONFIG[sd] = "imx8mm_rom5721a1_2G_config,sdcard"
UBOOT_CONFIG[fspi] = "imx8mm_rom5721a1_2G_fspi_defconfig"

SPL_BINARY = "spl/u-boot-spl.bin"

# Set DDR FIRMWARE
DDR_FIRMWARE_NAME = "lpddr4_pmu_train_1d_imem.bin lpddr4_pmu_train_1d_dmem.bin lpddr4_pmu_train_2d_imem.bin lpddr4_pmu_train_2d_dmem.bin"

# Set u-boot DTB
UBOOT_DTB_NAME = "imx8mm-rom5721-a1.dtb"

# Set imx-mkimage boot target
IMXBOOT_TARGETS = "${@bb.utils.contains('UBOOT_CONFIG', 'fspi', 'flash_evk_flexspi', 'flash_evk', d)}"

SERIAL_CONSOLES = "115200;ttymxc1"

IMAGE_BOOTLOADER = "imx-boot"

LOADADDR = ""
IMX_BOOT_SEEK = "33"
```

## meta-fsl-imx/conf/machine/imx8mmrsb3730a2.conf
```bitbake
#@TYPE: Machine
#@NAME: NXP i.MX 8M Mini RSB3730 with LPDDR4
#@SOC: i.MX8MM

require include/adv-imx8mm-evk.inc

# The device tree name is implicit for LPDDR4, so can't use MACHINE here
KERNEL_DEVICETREE_BASENAME = "imx8mm-rsb3730-a2"

KERNEL_DEVICETREE += "freescale/imx8mm-rsb3730-a2.dtb"
KERNEL_DEVICETREE += "freescale/imx8mm-rsb3730-a2-dsi-auog101uan02.dtb"
KERNEL_DEVICETREE += "freescale/imx8mm-rsb3730-a2-dsi2lvds-1920x1080.dtb"
KERNEL_DEVICETREE += "freescale/imx8mm-rsb3730-a2-dsi2lvds-800x480.dtb "


UBOOT_CONFIG_BASENAME = "imx8mm_rsb3730a2"

UBOOT_CONFIG ??= "2G"
UBOOT_CONFIG[2G] = "${UBOOT_CONFIG_BASENAME}_2G_defconfig,sdcard"
UBOOT_CONFIG[FSPI_2G] = "${UBOOT_CONFIG_BASENAME}_2G_defconfig"
UBOOT_CONFIG[mfgtool] = "${UBOOT_CONFIG_BASENAME}_2G_defconfig"
UBOOT_CONFIG[4G] = "${UBOOT_CONFIG_BASENAME}_4G_defconfig,sdcard"
UBOOT_CONFIG[FSPI_4G] = "${UBOOT_CONFIG_BASENAME}_4G_defconfig"
UBOOT_CONFIG[mfgtool] = "${UBOOT_CONFIG_BASENAME}_4G_defconfig"

DDR_FIRMWARE_NAME = " \
    lpddr4_pmu_train_1d_imem.bin \
    lpddr4_pmu_train_1d_dmem.bin \
    lpddr4_pmu_train_2d_imem.bin \
    lpddr4_pmu_train_2d_dmem.bin \
"

IMXBOOT_TARGETS_BASENAME = "flash_evk"
```

## meta-fsl-imx/conf/machine/imx8mpepcr5710a1.conf
```bitbake
#@TYPE: Machine
#@NAME: NXP i.MX 8M Plus EPCR5710 with LPDDR4
#@SOC: i.MX8MP

require conf/machine/include/adv-imx8mp-evk.inc

# The device tree name is implicit for LPDDR4, so can't use MACHINE here
KERNEL_DEVICETREE_BASENAME = "imx8mp-epcr5710-a1"

# Mainline kernel contains only one DTB file for
# Advantech imx8mp machine
KERNEL_DEVICETREE = " \
                     freescale/imx8mp-epcr5710-a1.dtb \
                     freescale/recovery-imx8mp-epcr5710-a1.dtb \
"

UBOOT_CONFIG_BASENAME = "imx8mp_epcr5710a1"


UBOOT_CONFIG ??= "6G"
UBOOT_CONFIG[6G] = "imx8mp_epcr5710a1_6G_defconfig,sdcard"
UBOOT_CONFIG[4G] = "imx8mp_epcr5710a1_4G_defconfig,sdcard"
UBOOT_CONFIG[2G] = "imx8mp_epcr5710a1_2G_defconfig,sdcard"
UBOOT_CONFIG[FSPI_6G] = "imx8mp_epcr5710a1_6G_defconfig"
UBOOT_CONFIG[FSPI_4G] = "imx8mp_epcr5710a1_4G_defconfig"
UBOOT_CONFIG[FSPI_2G] = "imx8mp_epcr5710a1_2G_defconfig"
UBOOT_CONFIG[mfgtool] = "${UBOOT_CONFIG_BASENAME}_4G_defconfig"

# Set DDR FIRMWARE
DDR_FIRMWARE_VERSION = "202006"
DDR_FIRMWARE_NAME = " \
	lpddr4_pmu_train_1d_dmem_${DDR_FIRMWARE_VERSION}.bin \
	lpddr4_pmu_train_1d_imem_${DDR_FIRMWARE_VERSION}.bin \
	lpddr4_pmu_train_2d_dmem_${DDR_FIRMWARE_VERSION}.bin \
	lpddr4_pmu_train_2d_imem_${DDR_FIRMWARE_VERSION}.bin \
"

IMXBOOT_TARGETS = \
    "${@bb.utils.contains_any('UBOOT_CONFIG', 'FSPI_6G  FSPI_4G FSPI_2G', 'flash_evk_flexspi', \
                                                  'flash_evk', d)}"

# Set Serial console
SERIAL_CONSOLES = "115200;ttymxc1"
```

## meta-fsl-imx/conf/machine/imx8mpepcr5710a1desktop.conf
```bitbake
MACHINE="imx8mpepcr5710a1"
require conf/machine/imx8mpepcr5710a1.conf

require conf/machine/include/ubuntubasics.inc
```
